/*
 * Copyright (c) 2020 Pete Johanson
 *
 * SPDX-License-Identifier: MIT
 */

#include "corne.dtsi"

&kscan0 {
	col-gpios
		= <&pro_micro 21 GPIO_ACTIVE_HIGH>
		, <&pro_micro 20 GPIO_ACTIVE_HIGH>
		, <&pro_micro 19 GPIO_ACTIVE_HIGH>
		, <&pro_micro 18 GPIO_ACTIVE_HIGH>
		, <&pro_micro 15 GPIO_ACTIVE_HIGH>
		, <&pro_micro 14 GPIO_ACTIVE_HIGH>
		;
};

&chosen {
  zephyr,display = &nice_view;
};

// nice view bus
&spi0 {
  status = "okay";
  sck-pin = <20>;
  mosi-pin = <17>;
  miso-pin = <25>; // not connected port because it is not used
  cs-gpios = <&gpio0 8 GPIO_ACTIVE_HIGH>;
};

&nice_view {
  status = "okay";
};
