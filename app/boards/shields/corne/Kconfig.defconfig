## app/boards/shields/corne/Kconfig.defconfig
```kconfig
if SHIELD_CORNE_RIGHT

config ZMK_KEYBOARD_NAME
	default "Corne"

config ZMK_SPLIT_ROLE_CENTRAL
	default y

endif

if SHIELD_CORNE_LEFT || SHIELD_CORNE_RIGHT

config ZMK_SPLIT
	default y

config ZMK_DISPLAY
	select LVGL_FONT_MONTSERRAT_26

if ZMK_DISPLAY

config SPI
	default y

config LS0XX
	default y

config ZMK_WIDGET_WPM_STATUS
	default y if !ZMK_SPLIT || ZMK_SPLIT_ROLE_CENTRAL

endif # ZMK_DISPLAY

if ZMK_MOUSE

config SPI
  default y

endif # ZMK_MOUSE

if LVGL

config LVGL_VDB_SIZE
	default 64

config LVGL_DPI
	default 148

config LVGL_BITS_PER_PIXEL
	default 1

choice LVGL_COLOR_DEPTH
	default LVGL_COLOR_DEPTH_1
endchoice

endif # LVGL

endif
```
